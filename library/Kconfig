## library/Kconfig
```kconfig
menuconfig USER_SETTINGS
	bool "IoT User Settings"
	depends on SETTINGS
	depends on SETTINGS_RUNTIME
	default false

if USER_SETTINGS

rsource "protocol/Kconfig"
rsource "bt_service/Kconfig"

config USER_SETTINGS_HEAP_SIZE
	int "Available heap to load settings into"
	default 4096
	help
	  Note that allocations into this heap happen only once at initialization.

config USER_SETTINGS_SHELL
	bool "Shell for listing, reading and settings user settings"
	depends on SHELL
	default false

config USER_SETTINGS_JSON
	bool "Enable JSON settings encode / decode support"
	depends on CJSON_LIB
	default false

config USER_SETTINGS_DEFAULT_OVERWRITE
	bool "Allow default values to be overwritten"
	default false
	help
	  If enabled, user_settings_set_default_with_key() will no longer return an
	  error if a default already exists, but will replace it.

module = USER_SETTINGS
module-str = User settings
source "subsys/logging/Kconfig.template.log_config"

endif  # USER_SETTINGS
```

## library/bt_service/Kconfig
```kconfig
config USER_SETTINGS_BT_SERVICE
	bool "Enable bluetooth service for user settings"
	depends on BT_PERIPHERAL
	select USER_SETTINGS_PROTOCOL_EXECUTOR
	select USER_SETTINGS_PROTOCOL_BINARY

module = USER_SETTINGS_BT_SERVICE
module-str = User settings BT Service
source "subsys/logging/Kconfig.template.log_config"
```

## library/protocol/binary/Kconfig
```kconfig
config USER_SETTINGS_PROTOCOL_BINARY
	bool "Enable binary protocol for user usettings"
```

## library/protocol/executor/Kconfig
```kconfig
config USER_SETTINGS_PROTOCOL_EXECUTOR
	bool "Enable protocol executor for user usettings"
```

## tests/protocol_binary/testcase.yaml
```yaml
tests:
  user_settings.protocol_binary:
    platform_allow: native_sim
    harness: ztest
    extra_configs:
      # Disable fancy test, otherwise stdout parsing does not work.
      - CONFIG_FANCY_ZTEST=n
```

## tests/user_settings/testcase.yaml
```yaml
tests:
  user_settings.user_settings:
    platform_allow: native_posix
    extra_configs:
      # Disable fancy test, otherwise stdout parsing does not work.
      - CONFIG_FANCY_ZTEST=n
      - CONFIG_TEST_LOGGING_DEFAULTS=n
      - CONFIG_ASSERT=n
  user_settings.user_settings_with_default_override:
    platform_allow: native_posix
    extra_configs:
      # Disable fancy test, otherwise stdout parsing does not work.
      - CONFIG_FANCY_ZTEST=n
      - CONFIG_TEST_LOGGING_DEFAULTS=n
      - CONFIG_ASSERT=n
      - CONFIG_USER_SETTINGS_DEFAULT_OVERWRITE=y
```

## tests/user_settings_json/testcase.yaml
```yaml
tests:
  user_settings.user_settings_json:
    platform_allow: native_posix
    harness: ztest
    extra_configs:
      # Disable fancy test, otherwise stdout parsing does not work.
      - CONFIG_FANCY_ZTEST=n
```
